// SPDX-License-Identifier: (GPL-2.0+ OR MIT)
/*
 * Copyright (c) 2021 Rockchip Electronics Co., Ltd.
 *
 */

/dts-v1/;

#include "rk3588s-TVE1206R-v03.dtsi"

//#include "rk3588s-tve1206r.dtsi"
#include "rk3588-linux.dtsi"

/ {
	model = "Rockchip RK3588S TABLET RK806 SINGLE Board";
	compatible = "rockchip,rk3588s-tve1206r", "rockchip,rk3588";
};
